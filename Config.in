## Config.in
```kconfig
config BR2_CCTV_BOARD_VENDOR
	string "Vendor name"
        default "vendor"

config BR2_CCTV_BOARD_MODEL
	string "Model name"
        default "model"

source "$BR2_EXTERNAL_CCTV_PATH/board/Config.in"

menuconfig BR2_CCTV_KERNEL_CONFIG
	bool "Generate kernel config"
	default n
	help
		This option triggers kernel defconfig generation
		via merge_config_plus.

if BR2_CCTV_KERNEL_CONFIG
	config BR2_CCTV_KERNEL_CONFIG_SOURCE
		string "Source file"
		default "$BR2_EXTERNAL_CCTV_PATH/board/vendor/model/linux.config"
	
	config BR2_CCTV_KERNEP_CONFIG_OUTPUT
		string "Output file"
		default "$BUILD_DIR/build/cctv.tmp/kernel_defconfig"

	config BR2_LINUX_KERNEL_CUSTOM_CONFIG_FILE
		string "Kernel configuration file path"
		help
			This is duplicate of same var in native BR`s Kernel menu.
			Make sure that it`s value is same as output file above.
endif


comment "***"

#source "$BR2_EXTERNAL_CCTV_PATH/package/streamer/Config.in"
#source "$BR2_EXTERNAL_CCTV_PATH/package/www/Config.in"

#source "$BR2_EXTERNAL_CCTV_PATH/package/genimage-custom/Config.in.settings"
#source "$BR2_EXTERNAL_CCTV_PATH/package/swupdate-custom/Config.in.settings"

#menu "Dependency packages"
#        source "$BR2_EXTERNAL_CCTV_PATH/package/libdatachannel/Config.in"
#	source "$BR2_EXTERNAL_CCTV_PATH/package/usrsctp/Config.in"
#endmenu

#menu "Replacement packages"
#	comment "Newer version replacements for BR provided packages"
#	source "$BR2_EXTERNAL_CCTV_PATH/package/swupdate-custom/Config.in"
#	source "$BR2_EXTERNAL_CCTV_PATH/package/libuv-custom/Config.in"
#	source "$BR2_EXTERNAL_CCTV_PATH/package/libwebsockets-custom/Config.in"
#	source "$BR2_EXTERNAL_CCTV_PATH/package/libsrtp-custom/Config.in"
#endmenu

menu "Host tools"
	comment "Additional and newer version host tools"
	source "$BR2_EXTERNAL_CCTV_PATH/package/esh/Config.in.host"
#	source "$BR2_EXTERNAL_CCTV_PATH/package/genimage-custom/Config.in.host"
endmenu

#comment "***"

#menu "System settings"
#        config BR2_CCTV_SYSTEM_VERSION
#                string "Version"
#
#	config BR2_CCTV_SYSTEM_HOSTNAME
#		string "Hostname"
#		default "$(BR2_CCTV_BOARD_VENDOR)_$(BR2_CCTV_BOARD_MODEL)"
#
#	
#endmenu
#
#menuconfig BR2_CCTV_FIRMWARE
#	bool "Generate firmware"
#
#        select BR2_PACKAGE_HOST_ESH
#        select BR2_PACKAGE_HOST_GENIMAGE_CUSTOM
#
#	help
#		TODO
#
#if BR2_CCTV_FIRMWARE
#	choice BR2_CCTV_FIRMWARE_ROM
#        	prompt "ROM"
#
#	        config BR2_CCTV_FIRMWARE_ROM_SPINOR
#	                bool "SPI NOR"
#	endchoice
#
#	choice BR2_CCTV_FIRMWARE_LAYOUT
#		prompt "Layout"
#
#		config BR2_CCTV_FIRMWARE_LAYOUT_1P
#			bool "One system"
#	endchoice
#
#	config BR2_CCTV_FIRMWARE_LOADER
#		string "Loader"
#
#	config BR2_CCTV_FIRMWARE_KERNEL
#                string "Kernel"
#
#	config BR2_CCTV_FIRMWARE_ROOTFS
#		string "Root filesystem"
#
#	config BR2_CCTV_FIRMWARE_USER
#                string "User filesystem"
#endif

#menuconfig BR2_CCTV_OTA
#	bool "Generate OTA"
#
#	select BR2_CCTV_FIRMWARE
#
#	help
#		TODO

#if BR2_CCTV_OTA
#	comment "TODO"
#endif
```

## board/Config.in
```kconfig
config BR2_CCTV_PLATFORM_FH
	bool
config BR2_CCTV_PLATFORM_GOKE
        bool
config BR2_CCTV_PLATFORM_HISILICON
	bool
config BR2_CCTV_PLATFORM_SSTAR
	bool
config BR2_CCTV_PLATFORM_NT
	bool
config BR2_CCTV_PLATFORM_XM
        bool
################################################################################

choice BR2_CCTV_PLATFORM
        prompt "Platform"

        #config BR2_CCTV_PLATFORM_FH8856
        #        bool "Fullhan fh8856"
	#	 select BR2_CCTV_PLATFORM_FH

	config BR2_CCTV_PLATFORM_GK7205V200
                bool "Goke gk7205v200"
		select BR2_CCTV_PLATFORM_GOKE

        config BR2_CCTV_PLATFORM_HI3516AV100
                bool "HiSilicon hi3516av100"
		select BR2_CCTV_PLATFORM_HISILICON

        config BR2_CCTV_PLATFORM_HI3516AV200
                bool "HiSilicon hi3516av200"
		select BR2_CCTV_PLATFORM_HISILICON

        config BR2_CCTV_PLATFORM_HI3516CV100
                bool "HiSilicon hi3516cv100"
		select BR2_CCTV_PLATFORM_HISILICON

        config BR2_CCTV_PLATFORM_HI3516CV200
                bool "HiSilicon hi3516cv200"
		select BR2_CCTV_PLATFORM_HISILICON

        config BR2_CCTV_PLATFORM_HI3516CV300
                bool "HiSilicon hi3516cv300"
		select BR2_CCTV_PLATFORM_HISILICON

        config BR2_CCTV_PLATFORM_HI3516CV500
                bool "HiSilicon hi3516cv500"
		select BR2_CCTV_PLATFORM_HISILICON

        config BR2_CCTV_PLATFORM_HI3516EV200
                bool "HiSilicon hi3516ev200"
		select BR2_CCTV_PLATFORM_HISILICON

	config BR2_CCTV_PLATFORM_HI3519AV100
		bool "HiSilicon hi3519av100"
		select BR2_CCTV_PLATFORM_HISILICON

	config BR2_CCTV_PLATFORM_HI3536DV100
                bool "HiSilicon hi3536dv100"
                select BR2_CCTV_PLATFORM_HISILICON

        #config BR2_CCTV_PLATFORM_INFINITY6B0
        #        bool "SigmaStar infinity6b0"
	#	 select BR2_CCTV_PLATFORM_SSTAR

        #config BR2_CCTV_PLATFORM_INFINITY6E
        #        bool "SigmaStar infinity6e"
	#        select BR2_CCTV_PLATFORM_SSTAR

	#config BR2_CCTV_PLATFORM_NT9852x
        #        bool "Novatek nt9852x"
        #        select BR2_CCTV_PLATFORM_NT

	#config BR2_CCTV_PLATFORM_NT9856x
        #        bool "Novatek nt9856x"
        #        select BR2_CCTV_PLATFORM_NT

        config BR2_CCTV_PLATFORM_XM530
                bool "XiongMai xm530"
		select BR2_CCTV_PLATFORM_XM
endchoice

choice BR2_CCTV_PLATFORM_CHIP
        prompt "Chip"

        # HiSilicon hi3516av100 family {
	config BR2_CCTV_PLATFORM_HI3516AV100_HI3516AV100
                bool "hi3516av100"
                depends on BR2_CCTV_PLATFORM_HI3516AV100

        config BR2_CCTV_PLATFORM_HI3516CV100_HI3516DV100
                bool "hi3516dv100"
                depends on BR2_CCTV_PLATFORM_HI3516AV100
        # } // HiSilicon hi3516av100 family

        # HiSilicon hi3516av200 family {
	config BR2_CCTV_PLATFORM_HI3516AV200_HI3516AV200
                bool "hi3516av200"
                depends on BR2_CCTV_PLATFORM_HI3516AV200

        config BR2_CCTV_PLATFORM_HI3516AV200_HI3519V101
                bool "hi3510v101"
                depends on BR2_CCTV_PLATFORM_HI3516AV200
        # } // HiSilicon hi3516av200 family

        # HiSilicon hi356cv100 family {
        config BR2_CCTV_PLATFORM_HI3516CV100_HI3516CV100
                bool "hi3516cv100"
                depends on BR2_CCTV_PLATFORM_HI3516CV100

        config BR2_CCTV_PLATFORM_HI3516CV100_HI3518CV100
                bool "hi3518cv100"
                depends on BR2_CCTV_PLATFORM_HI3516CV100

        config BR2_CCTV_PLATFORM_HI3516CV100_HI3518EV100
                bool "hi3518ev100"
                depends on BR2_CCTV_PLATFORM_HI3516CV100
        # } //HiSilicon hi356cv100 family

        # HiSilicon hi3516cv200 family {
        # } // HiSilicon hi3516cv200 family

        # HiSilicon hi3516cv300 family {
	config BR2_CCTV_PLATFORM_HI3516CV300_HI3516CV300
		bool "hi3516cv300"
		depends on BR2_CCTV_PLATFORM_HI3516CV300

	config BR2_CCTV_PLATFORM_HI3516CV300_HI3516EV100
                bool "hi3516ev100"
                depends on BR2_CCTV_PLATFORM_HI3516EV100
        # } // HiSilicon hi3516cv300 family

        # HiSilicon hi3516cv500 family {
        # } // HiSilicon hi3516cv500 family

        # HiSilicon hi3516ev200 family {
        # } // HiSilicon hi3516ev200 family

        # HiSilicon hi3519av100 family {
        # } // HiSilicon hi3519av100 family

	# HiSilicon hi3536dv100 family {
        # } // HiSilicon hi3536dv100 family

	# SigmaStar infinity6b0 family {
        # } // SigmaStar infinity6b0 family

	# SigmaStar infinity6e family {
        # } // SigmaStar infinity6e family

	# Novatek nt9852x family {
        # } // Novatek nt9852x family

	# Novatek nt9856x family {
        # } // Novatek nt9856x family

        # XiongMai mx530 family {
        config BR2_CCTV_PLATFORM_XM530_XM530
                bool "xm530"
                depends on BR2_CCTV_PLATFORM_XM530

        config BR2_CCTV_PLATFORM_XM530_XM550
                bool "xm550"
                depends on BR2_CCTV_PLATFORM_XM550
        # } // XiongMai xm530 family
endchoice

	source "$BR2_EXTERNAL_CCTV_PATH/board/fullhan/Config.in"
	source "$BR2_EXTERNAL_CCTV_PATH/board/goke/Config.in"
	source "$BR2_EXTERNAL_CCTV_PATH/board/grainmedia/Config.in"
	source "$BR2_EXTERNAL_CCTV_PATH/board/hisilicon/Config.in"
	source "$BR2_EXTERNAL_CCTV_PATH/board/novatek/Config.in"
	source "$BR2_EXTERNAL_CCTV_PATH/board/sigmastar/Config.in"
	source "$BR2_EXTERNAL_CCTV_PATH/board/xiongmai/Config.in"

        #config BR2_CCTV_BOARD_RAM
        #        int "RAM size, bytes"
        #        default 0
        #        help
        #                Common values:
        #                32M  33554432
        #                64M  67108864
        #                128M 134217728
        #                256M 268435456
        #                512M 536870912
```

## board/hisilicon/Config.in
```kconfig
if BR2_CCTV_PLATFORM_HISILICON
	config BR2_CCTV_PLATFORM_HISI_UBOOT2010_06
	        bool
		default y
		depends on 	BR2_CCTV_PLATFORM_HI3516AV100 || \
				BR2_CCTV_PLATFORM_HI3516AV200 || \
				BR2_CCTV_PLATFORM_HI3516CV100 || \
				BR2_CCTV_PLATFORM_HI3516CV200 || \
				BR2_CCTV_PLATFORM_HI3516CV300 || \
				BR2_CCTV_PLATFORM_HI3536DV100

	config BR2_CCTV_PLATFORM_HISI_UBOOT2016_11
        	bool
		default y
		depends on	BR2_CCTV_PLATFORM_HI3516CV500 || \
                                BR2_CCTV_PLATFORM_HI3516EV200 || \
                                BR2_CCTV_PLATFORM_HI3519AV100

	menuconfig BR2_CCTV_PLATFORM_HISI_UBOOT2010_06_CUSTOM
		bool "Customize Uboot 2010.06"
		depends on BR2_TARGET_UBOOT
		depends on BR2_CCTV_PLATFORM_HISI_UBOOT2010_06
		select BR2_PACKAGE_HOST_ESH

	if BR2_CCTV_PLATFORM_HISI_UBOOT2010_06_CUSTOM
		comment "Option 1"
		comment "Option 2"
		comment "Option ..."
		config BR2_TARGET_UBOOT_BOARDNAME
			string "Uboot board name"
			help
				This is duplicate of same item from native BR`s menu.
				Make sure that it is 'hi3516c'
		
	        config BR2_CCTV_UBOOT_REGBIN
	                string "Patch uboot with regbin table file"
	                default ""
	                help
	                        Will not be patched if empty
				If patched saved as images/u-boot-regbin.bin
	endif

	menuconfig BR2_CCTV_PLATFORM_HISI_UBOOT2016_11_CUSTOM
		bool "Customize Uboot 2016.11"
                depends on BR2_TARGET_UBOOT
		depends on BR2_CCTV_PLATFORM_HISI_UBOOT2016_11

	if BR2_CCTV_PLATFORM_HISI_UBOOT2016_11_CUSTOM
		config BR2_CCTV_UBOOT_SOURCE
			string "Source config file"

		config BR2_CCTV_UBOOT_SOURCE
                        string "Output config file"

		config BR2_TARGET_UBOOT_CUSTOM_CONFIG_FILE
			string "uboot dup"
			help 
				TODO

		config BR2_CCTV_UBOOT_REGBIN
                        string "Patch uboot with regbin table file"
                        default ""
                        help
                                Will not be patched if empty
                                If patched saved as images/u-boot-regbin.bin
	endif
endif
```

## board/xm/Config.in
```kconfig
if BR2_CCTV_PLATFORM_XM

	config BR2_CCTV_PLATFORM_XM_UBOOT2014_04
	        bool

endif
```

## package/esh/Config.in.host
```kconfig
config BR2_PACKAGE_HOST_ESH
        bool "host esh"
	
	default n

	help
		ESH – Embedded SHell.
		Templating engine for evaluating shell commands embedded in arbitrary templates.
		https://github.com/jirutka/esh
```

## package/genimage-custom/Config.in.host
```kconfig
config BR2_PACKAGE_HOST_GENIMAGE_CUSTOM
        bool "host genimage custom"

	depends on !BR2_PACKAGE_GENIMAGE

	default n

        help
          genimage is a tool to generate multiple filesystem and flash
          images from a given root filesystem tree. genimage is
          intended to be run in a fakeroot environment.

          Configuration is done in a config file parsed by
          libconfuse. Options like the path to tools can be given in
          environment variables, the config file or commandline
          switches.

          https://github.com/pengutronix/genimage

comment "!!! host genimage custom is mutually exclusive with genimage"
	depends on BR2_PACKAGE_GENIMAGE
```

## package/hisilicon/hi-sdk/Config.in
```kconfig
menuconfig BR2_PACKAGE_HI_SDK
        bool "HiSilicon komods and libs"
        default n

if BR2_PACKAGE_HI_SDK
config BR2_PACKAGE_HI_SDK_FAMILY
	string "family name"
	default "hi3516cv100"

config BR2_PACKAGE_HI_SDK_VERSION
        string "version"
        default "1.0.b.0"

config BR2_PACKAGE_HI_SDK_TARGET_KOMODS
        bool "target ko modules"
        default n

config BR2_PACKAGE_HI_SDK_TARGET_KOMODS_LIST
        string "ko modules list"
        default "all"
        depends on BR2_PACKAGE_HI_SDK_TARGET_KOMODS

config BR2_PACKAGE_HI_SDK_TARGET_LIBS
        bool "target shared libs"
        default n

config BR2_PACKAGE_HI_SDK_TARGET_LIBS_LIST
        string "shared libs list"
        default "all"
        depends on BR2_PACKAGE_HI_SDK_TARGET_LIBS
endif
```

## package/overrides/libsrtp-custom/Config.in
```kconfig
config BR2_PACKAGE_LIBSRTP_CUSTOM
	bool "libsrtp custom"
	help
	  This package provides an implementation of the Secure
	  Real-time Transport Protocol (SRTP), the Universal Security
	  Transform (UST), and a supporting cryptographic kernel.

	  https://github.com/cisco/libsrtp
```

## package/overrides/libuv-custom/Config.in
```kconfig
config BR2_PACKAGE_LIBUV_CUSTOM
	bool "libuv custom"

	depends on BR2_TOOLCHAIN_HAS_THREADS_NPTL # pthread_barrier_*
	depends on BR2_USE_MMU # fork()
	depends on !BR2_STATIC_LIBS
	depends on BR2_TOOLCHAIN_HAS_SYNC_4
	depends on !BR2_PACKAGE_LIBUV

	default n

	help
	  libuv is a multi-platform support library with a focus
	  on asynchronous I/O.

	  https://github.com/libuv/libuv

comment "!!! libuv custom needs a toolchain w/ NPTL, dynamic library"
	depends on !BR2_TOOLCHAIN_HAS_THREADS_NPTL || BR2_STATIC_LIBS
	depends on BR2_USE_MMU
	depends on BR2_TOOLCHAIN_HAS_SYNC_4

comment "!!! libuv custom is mutually exclusive with libuv"
	depends on BR2_PACKAGE_LIBUV
```

## package/overrides/libwebsockets-custom/Config.in
```kconfig
config BR2_PACKAGE_LIBWEBSOCKETS_CUSTOM
	bool "libwebsockets"

	depends on !BR2_STATIC_LIBS
	select BR2_PACKAGE_ZLIB
	depends on !BR2_PACKAGE_LIBWEBSOCKETS

	default n

	help
	  Libwebsockets is a lightweight pure C library built to use
	  minimal CPU and memory resources, and provide fast throughput
	  in both directions.

	  https://libwebsockets.org/

comment "!!! libwebsockets custom needs a toolchain w/ dynamic library"
	depends on BR2_STATIC_LIBS

comment "!!! libwebsockets custom is mutually exlusive with libwebsockets"
	depends on BR2_PACKAGE_LIBWEBSOCKETS
```
